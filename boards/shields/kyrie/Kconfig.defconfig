## boards/shields/kyrie/Kconfig.defconfig
```kconfig
# Copyright (c) 2021 The ZMK Contributors
# SPDX-License-Identifier: MIT

if SHIELD_KYRIE_LEFT

config ZMK_KEYBOARD_NAME
    default "Kyrie"

config ZMK_SPLIT_ROLE_CENTRAL
    default y

endif

if SHIELD_KYRIE_LEFT || SHIELD_KYRIE_RIGHT

config ZMK_SPLIT
    default y

endif
```

## boards/shields/kyrie/Kconfig.shield
```kconfig
# Copyright (c) 2021 The ZMK Contributors
# SPDX-License-Identifier: MIT

config SHIELD_KYRIE_LEFT
    def_bool $(shields_list_contains,kyrie_left)

config SHIELD_KYRIE_RIGHT
    def_bool $(shields_list_contains,kyrie_right)
```
